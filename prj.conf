## CMakeLists.txt
```
#
# Copyright (c) 2019 Nordic Semiconductor
#
# SPDX-License-Identifier: LicenseRef-Nordic-5-Clause
#

cmake_minimum_required(VERSION 3.20.0)

find_package(
  Zephyr
  REQUIRED
  HINTS
  $ENV{ZEPHYR_BASE})
project(balancer-robot-fw)

# Include application application event headers
zephyr_library_include_directories(src/events)

# Application sources NORDIC SDK APP START
target_sources(app PRIVATE src/main.cpp)

target_sources(
  app
  PRIVATE src/events/ack_event.c
          src/events/config_event.c
          src/events/control_event.c
          src/events/measurement_event.c)

target_sources(
  app
  PRIVATE src/modules/controller.c
          src/modules/sensor_simulated.c
          src/modules/stats.c
          src/modules/bluetooth_smp.c)
# NORDIC SDK APP END

# add_subdirectory(test)
```

## sysbuild.conf
```
SB_CONFIG_BOOTLOADER_MCUBOOT=y

# ------ MCUboot Signature Verification ON ------ 
# SB_CONFIG_BOOT_SIGNATURE_KEY_FILE="/home/royya/project-coding/iot/project/robot-balancer-fw/signing_key.pem"
# SB_CONFIG_BOOT_SIGNATURE_TYPE_ECDSA_P256=y

# ------ MCUboot Signature Verification OFF ------ 
SB_CONFIG_BOOT_SIGNATURE_TYPE_NONE=y

# ------ MCUboot More Options ------ 
# SB_CONFIG_SECURE_BOOT_NETCORE=y
# SB_CONFIG_NETCORE_APP_UPDATE=y
# SB_CONFIG_MCUBOOT_MODE_OVERWRITE_ONLY=y
```

## prj.conf
```kconfig
#
# Copyright (c) 2019 Nordic Semiconductor ASA
#
# SPDX-License-Identifier: LicenseRef-Nordic-5-Clause
#
# Enabling assert
CONFIG_ASSERT=y

# Logger configuration
CONFIG_LOG=y
CONFIG_LOG_BACKEND_UART=y

# Configuration required by Application Event Manager
CONFIG_APP_EVENT_MANAGER=y
CONFIG_HEAP_MEM_POOL_SIZE=2048
CONFIG_REBOOT=y

# General System Settings
CONFIG_SYSTEM_WORKQUEUE_STACK_SIZE=2048
CONFIG_MAIN_STACK_SIZE=2048
CONFIG_ISR_STACK_SIZE=2048

# Random number generator
# CONFIG_TEST_RANDOM_GENERATOR=y

##########################

# C++ Language Support
CONFIG_CPP=y
CONFIG_STD_CPP2B=y
CONFIG_GLIBCXX_LIBCPP=y

# Memory Management for C++
# Note: C++ often requires a larger heap for 'new' and STL containers
CONFIG_HEAP_MEM_POOL_SIZE=8192

# Optional C++ Features (Uncomment if needed)
CONFIG_CPP_RTTI=y
CONFIG_NEWLIB_LIBC=y

##########################

CONFIG_SECURE_BOOT=y

# Enable SMP Server
CONFIG_MCUMGR=y
CONFIG_MCUMGR_GRP_IMG=y

# CONFIG_MCUMGR_GRP_IMG dependencies
CONFIG_FLASH=y
CONFIG_IMG_MANAGER=y

# CONFIG_IMG_MANAGER dependencies
CONFIG_STREAM_FLASH=y

# CONFIG_MCUMGR dependencies
CONFIG_NET_BUF=y
CONFIG_ZCBOR=y

# Required for CONFIG_IMG_MANAGER
CONFIG_FLASH_MAP=y

# Enable BLE transfer
CONFIG_BT=y
CONFIG_BT_PERIPHERAL=y
CONFIG_BT_DEVICE_NAME="Roy SMP Server"
CONFIG_NCS_SAMPLE_MCUMGR_BT_OTA_DFU=y

CONFIG_NCS_SAMPLE_MCUMGR_BT_OTA_DFU=y
CONFIG_NCS_SAMPLE_MCUMGR_BT_OTA_DFU_SPEEDUP=y

CONFIG_SYSTEM_WORKQUEUE_STACK_SIZE=4096

#=====================================
#
#	STATE MACHINE FRAMEWORK (SMF)
#
#=====================================
# SMF
CONFIG_SMF=y
# Parent State (enables Hierarchical State Machine)
CONFIG_SMF_ANCESTOR_SUPPORT=y
# Initial Transition (not recommended to use)
CONFIG_SMF_INITIAL_TRANSITION=y
```

## debug-overlay.conf
```kconfig
# enable logs
CONFIG_STDOUT_CONSOLE=y

# General
CONFIG_DEBUG=y
CONFIG_ASSERT=y
CONFIG_STACK_USAGE=y
CONFIG_THREAD_RUNTIME_STATS=y
CONFIG_STACK_SENTINEL=y
CONFIG_INIT_STACKS=y

# enable RTT
CONFIG_LOG=y
CONFIG_LOG_TAG_MAX_LEN=2
CONFIG_LOG_TAG_DEFAULT="--"
CONFIG_LOG_BUFFER_SIZE=10000
CONFIG_SEGGER_RTT_BUFFER_SIZE_UP=10000
CONFIG_LOG_MODE_DEFERRED=y
CONFIG_USE_SEGGER_RTT=y
CONFIG_RTT_CONSOLE=y
CONFIG_LOG_MODE_OVERFLOW=y
# # enable console
CONFIG_CONSOLE=y


# Config logger
CONFIG_DEBUG_OPTIMIZATIONS=y
CONFIG_DEBUG_THREAD_INFO=y

# CONFIG_APP_LOG_LEVEL=LOG_LEVEL_INF
```

## src/main.cpp
```c
/*
 * Copyright (c) 2019 Nordic Semiconductor ASA
 *
 * SPDX-License-Identifier: LicenseRef-Nordic-5-Clause
 */
// main.cpp
#include "modules/bluetooth_smp.h"
#include <app_event_manager.h>
#include <array>
#include <chrono>
#include <concepts>
#include <config_event.h>
#include <cstdio>
#include <expected>
#include <limits>
#include <numeric>
#include <ranges>
#include <span>
#include <string_view>
#include <tuple>
#include <variant>
#include <zephyr/kernel.h>
#include <zephyr/logging/log.h>
#include <zephyr/random/random.h>
#include <zephyr/smf.h>

#define MODULE app
LOG_MODULE_REGISTER(app, 3);
#define INIT_VALUE1 3

// --- C++23 Feature Test Macros ---
#ifdef __has_include
#if __has_include(<ranges>)
#include <ranges>
#define HAS_RANGES 1
#endif
#endif

using namespace std::chrono_literals;
using namespace std::string_view_literals;
constexpr auto STATE_UPDATE_INTERVAL = 2000ms;
constexpr auto LOG_INTERVAL = 5000ms;

constexpr int32_t TEMP_THRESHOLD_START_MONITORING = 2000; // 20.00°C
constexpr int32_t TEMP_THRESHOLD_ALERT = 3000;			  // 30.00°C
constexpr int32_t TEMP_THRESHOLD_RECOVERY = 2500;		  // 25.00°C
constexpr int32_t CALIBRATION_REFERENCE_TEMP = 2250;	  // 22.50°C
constexpr int MAX_CALIBRATION_STEPS = 5;

std::expected<double, std::string> divide(double numerator, double denominator) {
	if (denominator == 0.0) {
		// Return the error wrapped in std::unexpected
		return std::unexpected("Error: Division by zero!");
	}
	// Return the successful result directly
	return numerator / denominator;
}

// --- Time utilities for Zephyr ---
inline auto zephyr_sleep_for(std::chrono::milliseconds duration) {
	k_msleep(duration.count());
}

inline auto zephyr_get_task_name() -> std::string_view {
	const char *name = k_thread_name_get(k_current_get());
	return name ? std::string_view{name} : "unnamed"sv;
}

// ---------------- Fixed-point helpers ----------------
constexpr int SCALE = 100;

constexpr int ipart(int v) {
	return v / SCALE;
}
constexpr int fpart(int v) {
	return v < 0 ? -(v % SCALE) : (v % SCALE);
}

// --- State Variant Definition ---
enum class StateId {
	IDLE,
	MONITORING,
	ALERT,
	CALIBRATING
};
struct IdleState {};
struct MonitoringState {
	int32_t average_temp_value;
	int sample_count;
};

struct AlertState {
	std::string_view message;
	int32_t threshold_temp_value;
};

struct CalibratingState {
	int32_t reference_temp_value;
	int calibration_step;
};

// ? variant is like Union with Type safety
// monostate enables the StateVariant type to be initialized without specifying the exact Variant type
using StateVariant = std::variant<std::monostate, IdleState, MonitoringState, AlertState, CalibratingState>;

// --- Overloaded Helper ---

template <typename... T> struct Overloaded : T... {
	using T::operator()...;
};
// deduction guide if using C++17. in C++20 solved by Class Template Argument Deduction (CTAD) for aggregates
// template <typename... T> Overloaded(T...) -> Overloaded<T...>; // no need

template <typename...> constexpr bool uncovered_type_exists = false;

// --- Concepts & Constraints ---
template <typename T>
concept SensorLike = requires(T t) {
	{ t.read() } -> std::convertible_to<int32_t>;
	{ t.get_id() } -> std::convertible_to<int>;
};

// --- Sensor Concepts Implementation ---
class TemperatureSensor {
  public:
	auto read() const -> int32_t {
		return 2350 + (sys_rand32_get() % 100); // 23.50 – 24.49
	}
	auto get_id() const -> int {
		return 1;
	}
};

class HumiditySensor {
  public:
	auto read() const -> int32_t {
		return 4500 + (sys_rand32_get() % 200); // 45.00 – 46.99
	}
	auto get_id() const -> int {
		return 2;
	}
};

class PressureSensor {
  public:
	auto read() const -> int32_t {
		return 101325 + (sys_rand32_get() % 500); // 1013.25+
	}
	auto get_id() const -> int {
		return 3;
	}
};

// --- State Machine with Variants & Visit ---
class StateMachine {
  private:
	StateVariant current_state_{IdleState{}};
	StateId current_id_{StateId::IDLE};

	std::array<int32_t, 10> temp_data_circbuf_{};
	size_t buffer_index_{0};

	mutable std::array<char, 128> format_buffer_{};

  public:
	[[nodiscard]] auto get_buffer_index() const -> size_t {
		return buffer_index_;
	}

	auto transition_to(StateVariant s) -> void {
		current_state_ = s;
		current_id_ = static_cast<StateId>(current_state_.index());
	}

	template <typename T> auto transition_to(T &&s) -> void {
		// another option is to use transition_to(StateVariant s) as param, but causes to call copy,
		// instead of moving rvalue

		auto old_id_ = current_id_;
		current_state_ = std::forward<T>(s);
		current_id_ = static_cast<StateId>(current_state_.index());
		LOG_INF("Transitioned State ID: from [%d] to [%d]", static_cast<int>(old_id_), static_cast<int>(current_id_));
	}

	auto get_state_info() const -> std::string_view {
		// clang-format off
		return std::visit(Overloaded{
			// this way, compiler enforces all Variant types to be covered, or else compilation error
			[this](const IdleState&) -> std::string_view {
				return "Status: Idle - Awaiting for sensor trigger"sv;
			},
			[this](const MonitoringState& s) -> std::string_view {
				// psst: not using std::format because the zephyr SDK does not have #include <format>
				int len = snprintf(format_buffer_.data(), format_buffer_.size(), 
									"Status: Monitoring [Avg: %d.%02d°C | Samples: %d]",
									ipart(s.average_temp_value), fpart(s.average_temp_value), s.sample_count);
				return { format_buffer_.data(), static_cast<size_t>(len) };
			},
			[this](const AlertState& s) -> std::string_view {
				int len = snprintf(format_buffer_.data(), format_buffer_.size(), 
								"Status: ALERT [%.*s | Threshold: %d.%02d°C]", 
								static_cast<int>(s.message.length()), s.message.data(),
								ipart(s.threshold_temp_value), fpart(s.threshold_temp_value));
				return {format_buffer_.data(), static_cast<size_t>(len)};
			},
			[this](const CalibratingState& s) -> std::string_view {
				int len = snprintf(format_buffer_.data(), format_buffer_.size(), 
								"Status: Calibrating [Ref: %d.%02d°C | Step: %d/5]", 
								ipart(s.reference_temp_value), fpart(s.reference_temp_value), s.calibration_step);
				return {format_buffer_.data(), static_cast<size_t>(len)};
			},
			[this](const auto&) -> std::string_view {
				// default fallback
				return "Status: Unknown State! [Error]"sv;
			}
		}, current_state_);
		// clang-format on
	}

	template <SensorLike... Sensors> auto process_sensors(Sensors &&...sensors) -> void {
		const std::array measurements{sensors.read()...};
		int temperatureSensorIdx = 0;

		// all sensor logic
		{
			int sensorIdx = 0;
			(
				[&]<typename T>(T &sensor) {
					const char *label = "Unknown";
					if constexpr (std::is_same_v<T, TemperatureSensor>) {
						label = "Temp";
						temperatureSensorIdx = sensorIdx;
					}
					if constexpr (std::is_same_v<T, HumiditySensor>)
						label = "Humid";
					if constexpr (std::is_same_v<T, PressureSensor>)
						label = "Press";

					LOG_INF("Sensor: %s | Value: %d", label, measurements[sensorIdx++]);
				}(sensors),
				...);
		}

		// TemperatureSensor value will cause system State change
		{
			const int32_t latest_temp = measurements[0];
			const size_t stored_count = std::min(buffer_index_, temp_data_circbuf_.size());

			// Update circular buffer
			temp_data_circbuf_[buffer_index_ % temp_data_circbuf_.size()] = latest_temp;
			buffer_index_++;

			std::visit(
				[this, latest_temp, stored_count]<typename Traw>(Traw &state) {
					using T = std::decay_t<Traw>; // cleanup any const/refs

					// this way, enforcement to ensure all Variant types are covered by the compiler becomes optional
					// (else, via static_assert). if I ommit the else, we can have a non-exhaustive "state machine"
					if constexpr (std::is_same_v<T, IdleState>) {
						if (latest_temp > TEMP_THRESHOLD_START_MONITORING) {
							transition_to(MonitoringState{latest_temp, 1});
						}
					} else if constexpr (std::is_same_v<T, MonitoringState>) {
						state.sample_count++;

						auto sum =
							std::accumulate(temp_data_circbuf_.begin(), temp_data_circbuf_.begin() + stored_count, 0LL);

						state.average_temp_value = static_cast<int32_t>(sum / stored_count);

						if (state.average_temp_value > TEMP_THRESHOLD_ALERT) {
							transition_to(AlertState{"Temperature High"sv, TEMP_THRESHOLD_ALERT});
						}
					} else if constexpr (std::is_same_v<T, AlertState>) {
						if (latest_temp < TEMP_THRESHOLD_RECOVERY) {
							transition_to(CalibratingState{CALIBRATION_REFERENCE_TEMP, 1});
						}
					} else if constexpr (std::is_same_v<T, CalibratingState>) {
						if (++state.calibration_step > MAX_CALIBRATION_STEPS) {
							transition_to(IdleState{});
						}
					} else if constexpr (std::is_same_v<T, std::monostate>) {
						transition_to(IdleState{});
					} else {
						// C++23: If a new state is added to StateVariant but not handled yet, force compile error
						static_assert(uncovered_type_exists<T>,
									  "Non-exhaustive visitor: You forgot to handle a state!");
					}
				},
				current_state_);
		}
	}

	auto get_history_range() const -> std::tuple<int32_t, int32_t> {
		if (buffer_index_ == 0) {
			return {0, 0};
		}

		const size_t stored_count = std::min(buffer_index_, temp_data_circbuf_.size());

		int32_t min_temp = temp_data_circbuf_[0];
		int32_t max_temp = temp_data_circbuf_[0];

		for (size_t i = 1; i < stored_count; ++i) {
			min_temp = std::min(min_temp, temp_data_circbuf_[i]);
			max_temp = std::max(max_temp, temp_data_circbuf_[i]);
		}

		return {min_temp, max_temp};
	}

	auto get_current_state_id() const -> StateId {
		return current_id_;
	}
};

// --- Thread-safe State Machine Manager ---
class StateMachineManager {
  private:
	StateMachine sm_;
	TemperatureSensor t_;
	HumiditySensor h_;
	PressureSensor p_;

  public:
	auto update() -> void {
		sm_.process_sensors(t_, h_, p_);

		auto [min_temp, max_temp] = sm_.get_history_range();
		auto info = sm_.get_state_info();

		LOG_INF("State: %.*s | Buffer: %zu | Range: [%d.%02d, %d.%02d]", (int)info.length(), info.data(),
				sm_.get_buffer_index(), ipart(min_temp), fpart(min_temp), ipart(max_temp), fpart(max_temp));
	}

	auto get_state_id() const -> StateId {
		return sm_.get_current_state_id();
	}
};
// --- Thread Functions ---
void state_monitor_thread([[maybe_unused]] void *p1, [[maybe_unused]] void *p2, [[maybe_unused]] void *p3) {
	const auto thread_id = reinterpret_cast<intptr_t>(p1);
	StateMachineManager manager;

	while (true) {
		// if with initializer
		if (auto state = manager.get_state_id(); state == StateId::ALERT) {
			LOG_WRN("Thread %ld: CRITICAL ALERT STATE", static_cast<long>(thread_id));
		}

		manager.update();
		zephyr_sleep_for(STATE_UPDATE_INTERVAL);
	}
}

void sensor_processor_thread([[maybe_unused]] void *p1, [[maybe_unused]] void *p2, [[maybe_unused]] void *p3) {
	// Changed from std::vector to std::array (static allocation)
	std::array<StateMachineManager, 3> managers{};

	// Range-based for with init
	for (size_t i = 0; auto &manager : managers) {
		LOG_INF("Initialized manager %zu", i++);
		manager.update();
	}

	while (true) {
		// Process each manager
		for (auto &manager : managers) {
			manager.update();
		}

		zephyr_sleep_for(1000ms);
	}
}

// --- Thread stack definitions ---
K_THREAD_STACK_DEFINE(state_mon_stack1, 4096);
K_THREAD_STACK_DEFINE(state_mon_stack2, 4096);
K_THREAD_STACK_DEFINE(sensor_proc_stack, 4096);
K_THREAD_STACK_DEFINE(main_stack, 2048);

// --- Thread structures ---
struct k_thread state_mon_thread1;
struct k_thread state_mon_thread2;
struct k_thread sensor_proc_thread;
struct k_thread main_thread;

// --- Main Application Thread ---
void main_thread_entry(void *p1, void *p2, void *p3) {
	LOG_INF("Starting C++23 State Machine Example on Zephyr");

	// Create threads
	k_thread_create(&state_mon_thread1, state_mon_stack1, K_THREAD_STACK_SIZEOF(state_mon_stack1), state_monitor_thread,
					reinterpret_cast<void *>(1), nullptr, nullptr, K_PRIO_COOP(5), 0, K_NO_WAIT);
	k_thread_name_set(&state_mon_thread1, "StateMon1");

	k_thread_create(&state_mon_thread2, state_mon_stack2, K_THREAD_STACK_SIZEOF(state_mon_stack2), state_monitor_thread,
					reinterpret_cast<void *>(2), nullptr, nullptr, K_PRIO_COOP(5), 0, K_NO_WAIT);
	k_thread_name_set(&state_mon_thread2, "StateMon2");

	k_thread_create(&sensor_proc_thread, sensor_proc_stack, K_THREAD_STACK_SIZEOF(sensor_proc_stack),
					sensor_processor_thread, nullptr, nullptr, nullptr, K_PRIO_COOP(6), 0, K_NO_WAIT);
	k_thread_name_set(&sensor_proc_thread, "SensorProc");

	// Main loop
	int cycle = 0;

	while (true) {
		LOG_INF("Main task cycle %d", ++cycle);
		zephyr_sleep_for(LOG_INTERVAL);
	}
}

extern "C" int main(void) {
	LOG_INF("Hello, again!");

#ifdef CONFIG_BT
	start_smp_bluetooth_adverts();
#endif // CONFIG_BT

	// Create main thread
	k_thread_create(&main_thread, main_stack, K_THREAD_STACK_SIZEOF(main_stack), main_thread_entry, nullptr, nullptr,
					nullptr, K_PRIO_COOP(4), 0, K_NO_WAIT);
	k_thread_name_set(&main_thread, "Main");

	// Let the scheduler run
	k_thread_join(&main_thread, K_FOREVER);

	if (app_event_manager_init()) {
		LOG_ERR("Application Event Manager not initialized");
	} else {
		struct config_event *event = new_config_event();

		event->init_value1 = INIT_VALUE1;
		APP_EVENT_SUBMIT(event);
	}

	return 0;
}
```
